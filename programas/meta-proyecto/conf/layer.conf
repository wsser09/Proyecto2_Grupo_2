## programas/meta-proyecto/conf/layer.conf
```bitbake
# We have a conf and classes directory, add to BBPATH
BBPATH .= ":${LAYERDIR}"

# We have recipes-* directories, add to BBFILES
BBFILES += "${LAYERDIR}/recipes-*/*/*.bb \
            ${LAYERDIR}/recipes-*/*/*.bbappend"

BBFILE_COLLECTIONS += "meta-proyecto"
BBFILE_PATTERN_meta-proyecto = "^${LAYERDIR}/"
BBFILE_PRIORITY_meta-proyecto = "8"

LAYERDEPENDS_meta-proyecto = "core"
LAYERSERIES_COMPAT_meta-proyecto = "kirkstone"
```
